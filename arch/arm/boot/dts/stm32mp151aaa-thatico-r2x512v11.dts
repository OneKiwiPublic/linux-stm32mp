// SPDX-License-Identifier: (GPL-2.0+ OR BSD-3-Clause)
/*
 * Copyright (C) STMicroelectronics 2019 - All Rights Reserved
 * Author: Alexandre Torgue <alexandre.torgue@st.com> for STMicroelectronics.
 */

/dts-v1/;

#include "stm32mp151.dtsi"
#include "stm32mp15xa.dtsi"
#include "stm32mp15-pinctrl.dtsi"
#include "stm32mp15xxaa-pinctrl.dtsi"
#include "stm32mp151aaa-thatico-r2x512v11.dtsi"
#include "stm32mp151aaa-thatico-r2x512v11-pin.dtsi"

/ {
	model = "THATICO STM32MP151AAA3 1GB V1.1 Board";
	compatible = "st,stm32mp151aaa-thatico-r2x512v11", "st,stm32mp151";

	aliases {
		i2c0 = &i2c1;
		i2c1 = &i2c2;
		i2c2 = &i2c3;
		i2c3 = &i2c4;
		i2c4 = &i2c5;
		serial0 = &uart4;
		serial1 = &usart3;
		serial2 = &usart2;
		usb0 = &usbotg_hs;
	};
	
	chosen {
		stdout-path = "serial0:115200n8";
	};
};
