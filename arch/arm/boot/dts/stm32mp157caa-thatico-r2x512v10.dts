// SPDX-License-Identifier: (GPL-2.0+ OR BSD-3-Clause)
/*
 * Copyright (C) STMicroelectronics 2019 - All Rights Reserved
 * Author: Alexandre Torgue <alexandre.torgue@st.com> for STMicroelectronics.
 */

/dts-v1/;

#include "stm32mp157.dtsi"
#include "stm32mp15xc.dtsi"
#include "stm32mp15-pinctrl.dtsi"
#include "stm32mp15xxaa-pinctrl.dtsi"
#include "stm32mp157caa-thatico-r2x512v10.dtsi"
#include "stm32mp157caa-thatico-r2x512v10-pin.dtsi"

/ {
	model = "THATICO STM32MP157CAA3 1GB V1.0 Board";
	compatible = "st,stm32mp157caa-thatico-r2x512v10", "st,stm32mp157";

	aliases {
		i2c1 = &i2c2;
		i2c3 = &i2c4;
		serial0 = &uart4;
		serial1 = &usart3;
		usb0 = &usbotg_hs;
	};
	
	chosen {
		stdout-path = "serial0:115200n8";
	};
};
