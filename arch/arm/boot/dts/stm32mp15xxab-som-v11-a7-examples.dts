// SPDX-License-Identifier: (GPL-2.0-or-later OR BSD-3-Clause)
/*
 * Copyright (C) STMicroelectronics 2022 - All Rights Reserved
 * Author: Alexandre Torgue <alexandre.torgue@foss.st.com> for STMicroelectronics.
 */

/dts-v1/;

#include "stm32mp15xxab-som-v11.dts"

/ {
	model = "OneKiwi STM32MP15xxAB SOM v1.1 (STM32MP157AAB) configured to run Linux A7 examples";
	compatible = "st,stm32mp15xxab-som-v11-a7-examples", "st,stm32mp15xxab-som-v11", "st,stm32mp157";
};

/*
&i2c5 {
	status = "okay";
};*/

/*
&uart7 {
	status = "okay";
};*/

/*
&usart3 {
	status = "okay";
};*/
